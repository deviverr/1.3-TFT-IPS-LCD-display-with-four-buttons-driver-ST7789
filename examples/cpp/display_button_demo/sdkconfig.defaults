## examples/cpp/display_button_demo/sdkconfig.defaults
```kconfig
CONFIG_IDF_TARGET="esp32s3"
CONFIG_FREERTOS_HZ=1000
CONFIG_ESP_MAIN_TASK_STACK_SIZE=8192
CONFIG_SPI_MASTER_ISR_IN_IRAM=y
CONFIG_LOG_DEFAULT_LEVEL_INFO=y
```
